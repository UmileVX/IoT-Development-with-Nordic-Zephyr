## CMakeLists.txt
```
cmake_minimum_required(VERSION 3.20.0)
find_package(Zephyr REQUIRED HINTS $ENV{ZEPHYR_BASE})

project(secondscounter_example2)

FILE(GLOB app_sources src/*.c)
target_sources(app PRIVATE ${app_sources})
```

## prj.conf
```kconfig
CONFIG_PRINTK=y
CONFIG_LOG=y
CONFIG_I2C=y
CONFIG_LED=y
CONFIG_KSCAN=y
CONFIG_KSCAN_INIT_PRIORITY=95
CONFIG_HT16K33_KEYSCAN=y
CONFIG_GPIO=y
```

## src/main.c
```c
#include <zephyr/kernel.h>
#include <zephyr/device.h>
#include <zephyr/devicetree.h>
#include <zephyr/sys/util.h>

#include "led.h"
#include "batterydisplay.h"
#include "value.h"

struct k_timer my_timer;
struct k_work my_work;

static int seconds = 0;

void my_work_handler(struct k_work *work)
{
        printk("Time: %d\n", seconds);

        // Display the time on the LED matrix
        led_on_seconds(seconds);

        // Display the time on the battery display
        if( seconds == 0){
                display_level(0);
        } else if(seconds > 0 && seconds < 10){
                display_level(1);
        } else if(seconds >= 10 && seconds < 20){
                display_level(2);
        } else if(seconds >= 20 && seconds < 30){
                display_level(3);
        } else if(seconds >= 30 && seconds < 40){
                display_level(4);
        } else if(seconds >= 40 && seconds < 50){
                display_level(5);
        } else if(seconds >= 50 && seconds < 56){
                display_level(6);
        } else {
                display_level(7);
        }


        // Increment the seconds
        seconds++;
        if(seconds > 59){
                seconds = 0;
        }
}

K_WORK_DEFINE(my_work, my_work_handler);

void my_timer_handler(struct k_timer *dummy)
{
        k_work_submit(&my_work);
}

K_TIMER_DEFINE(my_timer, my_timer_handler, NULL);

int main(void)
{
        printk("Seconds counter example 2\n");
        int ret = DK_OK;

        ret = batterydisplay_intit();
        if(ret != DK_OK){
                printk("Error initializing battery display\n");
                return DK_ERR;
        }

        ret = led_init();
        if(ret != DK_OK){
                printk("Error initializing LED\n");
                return DK_ERR;
        }

        // Start the timer
        k_timer_start(&my_timer, K_SECONDS(1), K_SECONDS(1));

        return DK_OK;
}
```

## src/batterydisplay.c
```c
#include "batterydisplay.h"
#include "value.h"

static int8_t leveltab[9] = {0x00,0x40,0x60,0x70,0x78,0x7c,0x7e,0x7f};//Level 0~7
static uint8_t cmd_dispctrl = DISPLAY_BRIGHTEST + BRIGHTNESS_LEVEL1;
static int setlevel = 0;

// Function to initialize the battery display
int batterydisplay_intit(void)
{
    if (!gpio_is_ready_dt(&clk)) {
		printk("clk GPIO is not ready\n");
		return DK_ERR;
	}

	if(!gpio_is_ready_dt(&dio)) {
		printk("dio GPIO is not ready\n");
		return DK_ERR;
	}

    printk("batterydisplay_init success\n");

    return DK_OK;
}

void set_brightness(int brightness)
{
    cmd_dispctrl = DISPLAY_BRIGHTEST + brightness;
}

void set_level(int level)
{
    setlevel = level;
}

void write_byte(int8_t wr_data)
{
    uint8_t data = wr_data;

    for(uint8_t i = 0; i < 8; i++){
        gpio_pin_configure_dt(&clk, GPIO_OUTPUT);
        bit_delay();

        if(data & 0x01)
            gpio_pin_configure_dt(&dio, GPIO_INPUT);
        else
            gpio_pin_configure_dt(&dio, GPIO_OUTPUT);

        bit_delay();

        gpio_pin_configure_dt(&clk, GPIO_INPUT);
        bit_delay();

        data >>= 1;
    }

    gpio_pin_configure_dt(&clk, GPIO_OUTPUT);
    gpio_pin_configure_dt(&dio, GPIO_INPUT);
    bit_delay();

    gpio_pin_configure_dt(&clk, GPIO_INPUT);
    bit_delay();
    uint8_t ack = gpio_pin_get_dt(&dio);
    if(ack == 0){
        gpio_pin_configure_dt(&dio, GPIO_OUTPUT);
    }

    bit_delay();
    gpio_pin_configure_dt(&clk, GPIO_OUTPUT);
    bit_delay();
}

void start(void)
{
    gpio_pin_configure_dt(&dio, GPIO_OUTPUT);
    bit_delay();
}

void stop(void)
{
    gpio_pin_configure_dt(&dio, GPIO_OUTPUT);
    bit_delay();

    gpio_pin_configure_dt(&clk, GPIO_INPUT);
    bit_delay();

    gpio_pin_configure_dt(&dio, GPIO_INPUT);
    bit_delay();
}

int display_level(uint8_t level)
{
    if(level > 7){
        printk("Invalid level\n");
        return DK_ERR;
    }

    if( setlevel == level){
        // printk("Same level\n");
        return DK_OK;
    }

    set_level(level);
    printk("display_level: %d\n", level);

    start();
    write_byte(ADDR_FIXED);
    stop();

    start();
    write_byte(ADDR_CMD_00H);
    write_byte(leveltab[level]);
    stop();

    start();
    write_byte(cmd_dispctrl);
    stop();

    printk("display_level success\n");

    return DK_OK;
}

void display_frame(bool framgeflag)
{
    int8_t segdata;
    if(framgeflag == FRAME_ON)
        segdata = 0x40;
    else
        segdata = 0x00;

    start();
    write_byte(ADDR_AUTO);
    stop();

    start();
    write_byte(ADDR_CMD_01H);
    for(uint8_t i = 0; i < 3; i++){
        write_byte(segdata);
    }
    stop();

    start();
    write_byte(cmd_dispctrl);
    stop();
}

void display_clear(void)
{
    display_level(0);
    display_frame(FRAME_OFF);
}

void bit_delay(void)
{
    k_sleep(K_TICKS(1));
}
```

## src/batterydisplay.h
```c
#include <zephyr/devicetree.h>
#include <zephyr/kernel.h>
#include <zephyr/drivers/gpio.h>

#define CLK_NODE DT_NODELABEL(gpioclk)
#if !DT_NODE_HAS_STATUS(CLK_NODE, okay)
#error "Unsupported board: gpioclk devicetree alias is not defined or enabled"
#endif
static const struct gpio_dt_spec clk = GPIO_DT_SPEC_GET(CLK_NODE, gpios);

#define DIO_NODE DT_NODELABEL(gpiodio)
#if !DT_NODE_HAS_STATUS(DIO_NODE, okay)
#error "Unsupported board: gpiodio devicetree alias is not defined or enabled"
#endif
static const struct gpio_dt_spec dio = GPIO_DT_SPEC_GET(DIO_NODE, gpios);


#define ADDR_FIXED 0x44
#define ADDR_AUTO  0x40

#define ADDR_CMD_00H 0xc0
#define ADDR_CMD_01H 0xc1
#define ADDR_CMD_02H 0xc2
#define ADDR_CMD_03H 0xc3

#define FRAME_OFF false
#define FRAME_ON true

#define DISPLAY_BRIGHTEST 0x88

#define BRIGHTNESS_LEVEL0 0
#define BRIGHTNESS_LEVEL1 1
#define BRIGHTNESS_LEVEL2 2
#define BRIGHTNESS_LEVEL3 3
#define BRIGHTNESS_LEVEL4 4
#define BRIGHTNESS_LEVEL5 5
#define BRIGHTNESS_LEVEL6 6
#define BRIGHTNESS_LEVEL7 7


int batterydisplay_intit(void);
void set_brightness(int brightness);
void set_level(int level);
void write_byte(int8_t wr_data);

void start(void);
void stop(void);

int display_level(uint8_t level);
void display_frame(bool framgeflag);
void display_clear(void);

void bit_delay(void);
```

## src/led.c
```c
#include "led.h"
#include "value.h"

int number_led_matrix_arr [MAX_LED_MATRIX_IDX+1][MAX_LED_MATRIX_NUM+1];

// Function to initialize the LED matrix
int led_init(void)
{
    if(!device_is_ready(led)){
        printk("LED device %s is not ready\n", led->name);
        return DK_ERR;
    }

    for(int i = 0; i< MAX_LED_NUM; i++){
        led_off(led, i);
    }

    return DK_OK;
}

void led_on_seconds(int seconds)
{
    int tens = seconds / 10;
    int units = seconds % 10;

    int num_arr_idx = 0;

    for(int i = 0; i < MAX_LED_NUM; i+=16){
        for(int j = i; j < (i+8); j++){
            if(number_led_matrix_arr[tens][num_arr_idx] == 1){
                // printk("[tens] led_on: j:[%d] num_array_idx[%d]\n", j, num_arr_idx);
                led_on(led, j);
            } else {
                led_off(led, j);
            }

            num_arr_idx++;
        }
    }

    num_arr_idx = 0;

    for(int i = 0; i < MAX_LED_NUM; i+=16){
        for(int j = (i+8); j < (i+16); j++){
            if(number_led_matrix_arr[units][num_arr_idx] == 1){
                // printk("[units] led_on: j:[%d] num_array_idx[%d]\n", j, num_arr_idx);
                led_on(led, j);
            } else {
                led_off(led, j);
            }
            num_arr_idx++;
        }
    }

}

int number_led_matrix_arr [MAX_LED_MATRIX_IDX+1][MAX_LED_MATRIX_NUM+1]= {
    { // 0
        0,0,0,1,1,1,0,0,
        0,0,1,0,0,0,1,0,
        0,0,1,0,0,0,1,0,
        0,0,1,0,0,0,1,0,
        0,0,1,0,0,0,1,0,
        0,0,1,0,0,0,1,0,
        0,0,1,0,0,0,1,0,
        0,0,0,1,1,1,0,0
    },
    { // 1
        0,0,0,0,1,0,0,0,
        0,0,0,1,1,0,0,0,
        0,0,1,0,1,0,0,0,
        0,0,0,0,1,0,0,0,
        0,0,0,0,1,0,0,0,
        0,0,0,0,1,0,0,0,
        0,0,0,0,1,0,0,0,
        0,0,1,1,1,1,1,0
    },
    { // 2
        0,0,0,0,1,0,0,0,
        0,0,0,1,0,1,0,0,
        0,0,1,0,0,0,1,0,
        0,0,0,0,0,1,0,0,
        0,0,0,0,1,0,0,0,
        0,0,0,1,0,0,0,0,
        0,0,1,0,0,0,0,0,
        0,0,1,1,1,1,1,0
    },
    { // 3
        0,0,1,1,1,1,0,0,
        0,0,0,0,0,0,1,0,
        0,0,0,0,0,0,1,0,
        0,0,1,1,1,1,0,0,
        0,0,0,0,0,0,1,0,
        0,0,0,0,0,0,1,0,
        0,0,0,0,0,0,1,0,
        0,0,1,1,1,1,0,0
    },
    { // 4
        0,0,0,0,0,1,0,0,
        0,0,0,0,1,1,0,0,
        0,0,0,1,0,1,0,0,
        0,0,1,0,0,1,0,0,
        0,1,1,1,1,1,1,0,
        0,0,0,0,0,1,0,0,
        0,0,0,0,0,1,0,0,
        0,0,0,0,0,1,0,0
    },
    { // 5
        0,0,1,1,1,1,1,0,
        0,0,1,0,0,0,0,0,
        0,0,1,0,0,0,0,0,
        0,0,1,1,1,1,0,0,
        0,0,0,0,0,0,1,0,
        0,0,0,0,0,0,1,0,
        0,0,1,0,0,0,1,0,
        0,0,0,1,1,1,0,0
    },
    { // 6
        0,0,0,1,1,1,0,0,
        0,0,1,0,0,0,0,0,
        0,0,1,0,0,0,0,0,
        0,0,1,1,1,1,0,0,
        0,0,1,0,0,0,1,0,
        0,0,1,0,0,0,1,0,
        0,0,1,0,0,0,1,0,
        0,0,0,1,1,1,0,0
    },
    { // 7
        0,0,1,1,1,1,1,0,
        0,0,1,0,0,0,1,0,
        0,0,1,0,0,0,1,0,
        0,0,1,0,0,0,1,0,
        0,0,0,0,0,0,1,0,
        0,0,0,0,0,0,1,0,
        0,0,0,0,0,0,1,0,
        0,0,0,0,0,0,1,0
    },
    { // 8
        0,0,0,1,1,1,0,0,
        0,0,1,0,0,0,1,0,
        0,0,1,0,0,0,1,0,
        0,0,0,1,1,1,0,0,
        0,0,1,0,0,0,1,0,
        0,0,1,0,0,0,1,0,
        0,0,1,0,0,0,1,0,
        0,0,0,1,1,1,0,0
    },
    { // 9
        0,0,0,1,1,1,0,0,
        0,0,1,0,0,0,1,0,
        0,0,1,0,0,0,1,0,
        0,0,1,0,0,0,1,0,
        0,0,0,1,1,1,1,0,
        0,0,0,0,0,0,1,0,
        0,0,0,0,0,0,1,0,
        0,0,0,0,0,0,1,0
    }
};
```

## src/led.h
```c
#include <zephyr/drivers/led.h>
#include <zephyr/drivers/kscan.h>
#include <zephyr/devicetree.h>
#include <zephyr/kernel.h>

#define MAX_LED_MATRIX_IDX 10
#define MAX_LED_NUM 128
#define MAX_LED_MATRIX_NUM 64

#define TENS_START_INDEX 0
#define UNITS_START_INDEX 8

#define LED_NODE DT_COMPAT_GET_ANY_STATUS_OKAY(holtek_ht16k33)
#define KEY_NODE DT_CHILD(LED_NODE, keyscan)

static const struct device *const led = DEVICE_DT_GET(LED_NODE);

int led_init(void);
void led_on_seconds(int seconds);
```
